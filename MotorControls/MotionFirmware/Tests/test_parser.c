#include "vision_frame.h"
#include "crc16_ccitt.h"
#include <assert.h>
#include <limits.h>
#include <stdio.h>
#include <string.h>

static const vision_cmd_t normal = {1U, 258U, 1U, 1000, 2500, 1800U, -16};
/* Generated by:
 * uv run --with numpy --with opencv-python --with pyserial python -c
 * "import sys; sys.path.insert(0,r'VisionSystem\04_Source_Code');
 * from utils.uart_protocol import encode_detection_packet;
 * print(encode_detection_packet(258,1,100.0,250.0,180.0,-1.6).hex(' '))"
 */
static const uint8_t reference[18] = {
    0xAAU, 0x55U, 0x01U, 0x02U, 0x01U, 0x01U, 0xE8U, 0x03U, 0xC4U,
    0x09U, 0x08U, 0x07U, 0xF0U, 0xFFU, 0x96U, 0xFEU, 0x0DU, 0x0AU
};

static void equal_cmd(const vision_cmd_t *a, const vision_cmd_t *b)
{
    assert(a->type == b->type);
    assert(a->obj_id == b->obj_id);
    assert(a->class_id == b->class_id);
    assert(a->x_01mm == b->x_01mm);
    assert(a->y_01mm == b->y_01mm);
    assert(a->angle_01deg == b->angle_01deg);
    assert(a->corr_01deg == b->corr_01deg);
}

static vision_parse_result_t feed(vision_parser_t *p, const uint8_t *b,
                                  size_t len, vision_cmd_t *out)
{
    vision_parse_result_t result = VISION_PARSE_NONE;
    for (size_t i = 0U; i < len; ++i) {
        const vision_parse_result_t next = vision_parser_feed(p, b[i], out);
        if (next != VISION_PARSE_NONE) {
            result = next;
        }
        assert(p->used < VISION_FRAME_SIZE);
    }
    return result;
}

static void repair_crc(uint8_t *b)
{
    const uint16_t crc = crc16_ccitt(b, 14U);
    b[14] = (uint8_t)(crc & 0xFFU);
    b[15] = (uint8_t)(crc >> 8U);
}

static void roundtrip_and_splits(void)
{
    uint8_t b[18];
    assert(vision_frame_encode(&normal, b) == sizeof(b));
    assert(memcmp(b, reference, sizeof(b)) == 0);
    for (size_t split = 0U; split <= sizeof(b); ++split) {
        vision_parser_t p;
        vision_cmd_t out = {0};
        vision_parser_init(&p);
        (void)feed(&p, b, split, &out);
        (void)feed(&p, &b[split], sizeof(b) - split, &out);
        equal_cmd(&out, &normal);
        assert(p.frames_ok == 1U && p.used == 0U);
        assert(p.crc_errors == 0U && p.format_errors == 0U && p.resyncs == 0U);
        assert(feed(&p, b, sizeof(b), &out) == VISION_PARSE_FRAME_OK);
        assert(p.frames_ok == 2U);
    }
    for (uint8_t type = 1U; type <= 4U; ++type) {
        vision_cmd_t cmd = {type, UINT16_MAX, 2U, INT16_MIN, INT16_MAX, 3599U, INT16_MIN};
        vision_cmd_t out = {0};
        vision_parser_t p;
        vision_parser_init(&p);
        assert(vision_frame_encode(&cmd, b) == sizeof(b));
        assert(feed(&p, b, sizeof(b), &out) == VISION_PARSE_FRAME_OK);
        equal_cmd(&cmd, &out);
        cmd.corr_01deg = INT16_MAX;
        cmd.angle_01deg = 0U;
        cmd.class_id = 0U;
        assert(vision_frame_encode(&cmd, b) == sizeof(b));
        assert(feed(&p, b, sizeof(b), &out) == VISION_PARSE_FRAME_OK);
        equal_cmd(&cmd, &out);
    }
}

static void corruptions(void)
{
    for (size_t offset = 2U; offset <= 15U; ++offset) {
        for (unsigned int value = 0U; value <= UINT8_MAX; ++value) {
            uint8_t b[18];
            vision_parser_t p;
            vision_cmd_t out = normal;
            memcpy(b, reference, sizeof(b));
            if (value == b[offset]) {
                continue;
            }
            b[offset] = (uint8_t)value;
            vision_parser_init(&p);
            assert(feed(&p, b, sizeof(b), &out) == VISION_PARSE_CRC_ERR);
            equal_cmd(&out, &normal);
            assert(p.crc_errors == 1U && p.format_errors == 0U);
            assert(p.frames_ok == 0U && p.resyncs == 1U);
        }
    }
    for (size_t offset = 16U; offset < 18U; ++offset) {
        uint8_t b[18];
        vision_parser_t p;
        vision_cmd_t out = normal;
        memcpy(b, reference, sizeof(b));
        b[offset] ^= 1U;
        vision_parser_init(&p);
        assert(feed(&p, b, sizeof(b), &out) == VISION_PARSE_FORMAT_ERR);
        assert(p.format_errors == 1U && p.crc_errors == 0U && p.resyncs == 1U);
        equal_cmd(&out, &normal);
    }
}

static void invalid_fields(void)
{
    const size_t offsets[] = {2U, 2U, 5U, 10U, 10U, 10U};
    const uint8_t values[] = {0U, 5U, 3U, 0x10U, 0xFFU, 0U};
    const uint8_t angle_high[] = {0x0EU, 0xFFU, 0x80U};
    for (size_t i = 0U; i < 6U; ++i) {
        uint8_t b[18];
        vision_parser_t p;
        vision_cmd_t out = normal;
        memcpy(b, reference, sizeof(b));
        b[offsets[i]] = values[i];
        if (i >= 3U) {
            b[11] = angle_high[i - 3U];
        }
        repair_crc(b);
        vision_parser_init(&p);
        assert(feed(&p, b, sizeof(b), &out) == VISION_PARSE_FORMAT_ERR);
        assert(p.format_errors == 1U && p.crc_errors == 0U && p.resyncs == 1U);
        equal_cmd(&out, &normal);
    }
    uint8_t b[18];
    memset(b, 0xCC, sizeof(b));
    vision_cmd_t invalid = normal;
    invalid.type = 5U;
    assert(vision_frame_encode(&invalid, b) == 0U);
    invalid = normal;
    invalid.class_id = 3U;
    assert(vision_frame_encode(&invalid, b) == 0U);
    invalid = normal;
    invalid.angle_01deg = 3600U;
    assert(vision_frame_encode(&invalid, b) == 0U);
    assert(vision_frame_encode(NULL, b) == 0U);
    assert(vision_frame_encode(&normal, NULL) == 0U);
    for (size_t i = 0U; i < sizeof(b); ++i) {
        assert(b[i] == 0xCCU);
    }
}

static void recovery(void)
{
    const uint8_t garbage[] = {0U, 0x55U, 0xAAU, 0x12U, 0xAAU};
    uint8_t b[18];
    vision_cmd_t embedded = normal;
    embedded.obj_id = 0x55AAU;
    embedded.x_01mm = 0x55AA;
    assert(vision_frame_encode(&embedded, b) == sizeof(b));
    vision_parser_t p;
    vision_cmd_t out = {0};
    vision_parser_init(&p);
    assert(feed(&p, garbage, sizeof(garbage), &out) == VISION_PARSE_NONE);
    assert(feed(&p, b, sizeof(b), &out) == VISION_PARSE_FRAME_OK);
    equal_cmd(&out, &embedded);
    assert(p.resyncs == 2U && p.frames_ok == 1U);
    assert(p.crc_errors == 0U && p.format_errors == 0U);

    for (size_t cut = 1U; cut < sizeof(b); ++cut) {
        vision_parser_init(&p);
        (void)feed(&p, b, cut, &out);
        assert(feed(&p, b, sizeof(b), &out) == VISION_PARSE_FRAME_OK);
        equal_cmd(&out, &embedded);
        assert(p.frames_ok == 1U && p.used == 0U);
    }
    for (size_t cut = 2U; cut < sizeof(reference); ++cut) {
        vision_parser_init(&p);
        (void)feed(&p, reference, cut, &out);
        assert(feed(&p, reference, sizeof(reference), &out) == VISION_PARSE_FRAME_OK);
        assert(p.frames_ok == 1U && p.resyncs == 1U);
        assert(p.format_errors + p.crc_errors == 1U);
    }
    vision_parser_init(&p);
    memcpy(b, reference, sizeof(b));
    b[17] = 0xAAU;
    assert(feed(&p, b, sizeof(b), &out) == VISION_PARSE_FORMAT_ERR);
    assert(feed(&p, &reference[1], sizeof(reference) - 1U, &out) == VISION_PARSE_FRAME_OK);
    assert(p.resyncs == 1U && p.frames_ok == 1U && p.format_errors == 1U);
    memcpy(b, reference, sizeof(b));
    b[6] ^= 1U;
    assert(feed(&p, b, sizeof(b), &out) == VISION_PARSE_CRC_ERR);
    assert(feed(&p, reference, sizeof(reference), &out) == VISION_PARSE_FRAME_OK);
    assert(p.frames_ok == 2U && p.crc_errors == 1U);
    assert(p.format_errors == 1U && p.resyncs == 2U);

    for (size_t offset = 0U; offset < sizeof(reference); ++offset) {
        vision_parser_init(&p);
        (void)feed(&p, reference, offset, &out);
        (void)feed(&p, &reference[offset + 1U], sizeof(reference) - offset - 1U, &out);
        assert(feed(&p, reference, sizeof(reference), &out) == VISION_PARSE_FRAME_OK);
        equal_cmd(&out, &normal);
        assert(p.frames_ok == 1U && p.used == 0U);
    }
    for (size_t offset = 0U; offset <= sizeof(reference); ++offset) {
        vision_parser_init(&p);
        (void)feed(&p, reference, offset, &out);
        (void)vision_parser_feed(&p, 0xAAU, &out);
        (void)feed(&p, &reference[offset], sizeof(reference) - offset, &out);
        assert(feed(&p, reference, sizeof(reference), &out) == VISION_PARSE_FRAME_OK);
        equal_cmd(&out, &normal);
        assert(p.used == 0U);
    }
}

int main(void)
{
    roundtrip_and_splits();
    corruptions();
    invalid_fields();
    recovery();
    puts("Parser: wire oracle, 19 splits, 3570 byte corruptions, validation and resync PASS");
    return 0;
}
